## drivers/dma/Kconfig.smartbond
```kconfig
# Smartbond DMA Accelerator Configuration Options

# Copyright (c) 2023 Renesas Electronics Corporation
# SPDX-License-Identifier: Apache-2.0

config DMA_SMARTBOND
	bool "Smartbond DMA Accelerator driver"
	depends on DT_HAS_RENESAS_SMARTBOND_DMA_ENABLED
	default y
	help
	  Enable Smartbond DMA Accelerator Driver
```
